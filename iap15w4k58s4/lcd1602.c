
#include "iap15w4k58s4.h"

#define LCD1602_DATAPINS P2

sbit LCD1602_E=P4^1;
sbit LCD1602_RW=P4^2;
sbit LCD1602_RS=P4^4;

/*******************************************************************************
* 函 数 名         : Lcd1602_Delay1ms
* 函数功能		   : 延时函数，延时1ms
* 输    入         : c
* 输    出         : 无
* 说    名         : 该函数是在12MHZ晶振下，12分频单片机的延时。
*******************************************************************************/
static void lcd1602_delay1ms(void)	// @6.000MHz
{
	u8 i, j;

	i = 6;
	j = 211;
	do {
		while (--j);
	} while (--i);   	
}

/*******************************************************************************
* 函 数 名         : LcdWriteCom
* 函数功能		   : 向LCD写入一个字节的命令
* 输    入         : com
* 输    出         : 无
*******************************************************************************/
void lcd1602_write_com(u8 com)	  //写入命令
{
	LCD1602_E = 0;     //使能
	LCD1602_RS = 0;	   //选择发送命令
	LCD1602_RW = 0;	   //选择写入
	
	LCD1602_DATAPINS = com;     //放入命令
	delay_ms(1);

	LCD1602_E = 1;		//写入时序
	delay_ms(5);
	LCD1602_E = 0;
}

/*******************************************************************************
* 函 数 名         : LcdWriteData
* 函数功能		   : 向LCD写入一个字节的数据
* 输    入         : dat
* 输    出         : 无
*******************************************************************************/		   		   
void lcd1602_write_data(u8 dat)			//写入数据
{
	LCD1602_E = 0;	//使能清零
	LCD1602_RS = 1;	//选择输入数据
	LCD1602_RW = 0;	//选择写入

	LCD1602_DATAPINS = dat; //写入数据
	delay_ms(1);

	LCD1602_E = 1;   	//写入时序
	delay_ms(5);
	LCD1602_E = 0;
}

/*******************************************************************************
* 函 数 名       : LcdInit()
* 函数功能		 : 初始化LCD屏
* 输    入       : 无
* 输    出       : 无
*******************************************************************************/
void lcd1602_init()				//LCD初始化子程序
{
 	lcd1602_write_com(0x38);	//开显示
	lcd1602_write_com(0x0c);	//开显示不显示光标
	lcd1602_write_com(0x06);	//写一个指针加1
	lcd1602_write_com(0x01);	//清屏
	lcd1602_write_com(0x80);	//设置数据指针起点
}

void lcd1602_pos(u8 x, u8 y)
{
	x &= 0xf;
	y &= 0x1;
	
	if (y == 0) lcd1602_write_com(x|0x80);
	else lcd1602_write_com((x + 0x40)|0x80);
}

void lcd1602_disp(u8 *s, u8 len)
{
	u8 i;
	
	for (i = 0; i < len; i++) lcd1602_write_data(s[i]); 
}
